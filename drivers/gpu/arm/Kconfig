## drivers/gpu/arm/Kconfig
```kconfig
#
# (C) COPYRIGHT 2012 ARM Limited. All rights reserved.
#
# This program is free software and is provided to you under the terms of the GNU General Public License version 2
# as published by the Free Software Foundation, and any use by you of this program is subject to the terms of such GNU licence.
#
# A copy of the licence is included with the program, and can also be obtained from Free Software
# Foundation, Inc., 51 Franklin Street, Fifth Floor, Boston, MA  02110-1301, USA.
#
#


menu "ARM GPU Configuration"

menuconfig MALI_DDK_VERSION
	tristate "Mali support"
	default y
	help
	  Enable this option to build support for the ARM Mali-T7xx GPU.

	  To compile this driver as a module, choose M here:
	  this will generate a single module, called mali_kbase.

config MALI_BIFROST_R51P0
        depends on MALI_DDK_VERSION
        bool "Bifrost r51p0 driver"
source "drivers/gpu/arm/bv_r51p0/Kconfig"

endmenu
```

## drivers/input/touchscreen/novatek/nt36523_spi/Kconfig
```kconfig
# SPDX-License-Identifier: GPL-2.0-only
#
# Novatek NT36xxx touchscreen driver configuration
#
config TOUCHSCREEN_NOVATEK_NT36523_SPI
	tristate "Novatek NT36xxx SPI driver"
	depends on SPI
	help
	  Say Y here if you have a Novatek NT36xxx no flash touchscreen connected
	  to your system by SPI bus.

	  If unsure, say N.

config NOVATEK_TRUSTED_TOUCH
	bool "Novatek Trusted Touch"
	depends on TOUCHSCREEN_NT36XXX
	help
	  Say Y here to enable Novatek Trusted Touch.
	  If unsure, say N.
```
